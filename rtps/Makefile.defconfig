## rtps/Makefile.defconfig
```kconfig
# Enable disable tests here:
TEST_FLOAT 					?= 0
TEST_SORT 					?= 0
TEST_GTIMER					?= 0
TEST_WDT					?= 0 # requires CONFIG_RTPS_R52_WDT in trch/Makefile
TEST_RTI_TIMER				?= 0
TEST_RTPS_TRCH_MAILBOX		?= 0
TEST_RTPS_DMA 				?= 0
TEST_RTPS_DMA_CB 			?= 0
TEST_RTPS_MMU 				?= 0
TEST_RT_MMU 				?= 0 # depends on TEST_RT_MMU in TRCH
TEST_SOFT_RESET 			?= 0

# Set build configuration here
CONFIG_EL2					?= 0
CONFIG_GTIMER 				?= 1
CONFIG_SLEEP_TIMER 			?= 1 # implement sleep() using a timer
CONFIG_SMP  				?= 0
CONFIG_SPLIT				?= 0
CONFIG_WDT 					?= 1
CONFIG_RTPS_TRCH_MAILBOX  	?= 1
CONFIG_HPPS_RTPS_MAILBOX  	?= 1
CONFIG_CONSOLE				?= NS16550
CONFIG_UART_BASE			?= LSIO_UART1_BASE
CONFIG_UART_BAUDRATE		?= 500000

# Generic Timer counter freq (CNTFRQ)
CONFIG_COUNTER_FREQUENCY    ?= 125000000
```

## trch-bl0/Makefile.defconfig
```kconfig
# Enable/disable standalone tests here:

# Set build configuration here
CONFIG_CONSOLE			?= NS16550
CONFIG_UART_BASE		?= LSIO_UART0_BASE
CONFIG_UART_BAUDRATE		?= 500000

# Note: these are replicas of one and only config, not config variants
CONFIG_CFG_ADDR_0 ?= 0x00000000
CONFIG_CFG_ADDR_1 ?= 0x00100000

CONFIG_RELOC_ADDR ?= 0x000f0000

# TODO: once GPIO implemented, make this unset by default (but keep for testing)
CONFIG_BOOT_SELECT = \
    BS_SRAM_INTERFACE \
    BS_SRAM_NOR \
    BS_MEM_RANK0 \
    BS_CONFIGURATION_OFFSET0 \
    BS_FAILOVER_DISABLE \
    BS_PARITY_EVEN \
```

## trch/Makefile.defconfig
```kconfig
# Enable/disable standalone tests here:
TEST_FLOAT 						?= 0
TEST_SYSTICK					?= 0
TEST_WDTS 						?= 0
TEST_TRCH_DMA					?= 0
TEST_TRCH_DMA_CB 				?= 0 # if set, use callback, otherwise call dma_wait
TEST_RT_MMU						?= 0
TEST_RT_MMU_BASIC				?= 0
TEST_RT_MMU_32_ACCESS_PHYSICAL	?= 0 # currently fails
TEST_RT_MMU_MAPPING_SWAP		?= 0 # incompatible with RTPS's TEST_RT_MMU
TEST_ETIMER						?= 0
TEST_RTI_TIMER					?= 0
TEST_SHMEM						?= 0

# Set build configuration here
CONFIG_RELEASE					?= 0

CONFIG_SYSTICK					?= 1
CONFIG_SLEEP_TIMER 				?= 1 # implement sleep() using a timer

# If you override the location of syscfg blob in TRCH SRAM, also update trch.ld
CONFIG_SYSCFG_MEM    			?= TRCH_SRAM
CONFIG_SYSCFG_ADDR				?= 0xff000

CONFIG_SMC						?= 1
CONFIG_SFS						?= 1
CONFIG_HPPS_TRCH_MAILBOX 		?= 1
CONFIG_HPPS_TRCH_MAILBOX_ATF 	?= 1
CONFIG_HPPS_TRCH_MAILBOX_SSW 	?= 1
CONFIG_RTPS_TRCH_MAILBOX 		?= 1
CONFIG_RTPS_A53_TRCH_MAILBOX_PSCI	?= 0
CONFIG_RTPS_TRCH_SHMEM			?= 1
CONFIG_HPPS_TRCH_SHMEM			?= 1
CONFIG_HPPS_TRCH_SHMEM_SSW 		?= 1
CONFIG_TRCH_WDT 				?= 1
CONFIG_RTPS_R52_WDT 			?= 1
CONFIG_RTPS_A53_WDT 			?= 1
CONFIG_HPPS_WDT 				?= 1
CONFIG_TRCH_DMA 				?= 1
CONFIG_RT_MMU 					?= 1 # RTPS/TRCH->HPPS MMU
CONFIG_CONSOLE					?= NS16550
CONFIG_UART_BASE				?= LSIO_UART0_BASE
CONFIG_UART_BAUDRATE			?= 500000
```
